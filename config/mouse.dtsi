#include <dt-bindings/zmk/mouse.h>

&mmv {
  acceleration-exponent = <1>;      // 1
  time-to-max-speed-ms = <1500>;    // 40
  delay-ms = <0>;                   // 0
};

&mwh {
  acceleration-exponent = <1>;      // 0
  time-to-max-speed-ms = <700>;    // 40
  delay-ms = <0>;                   // 10
};

#define MOUSE_MOVE_MAX 2000      // 600
#define MOUSE_SCROLL_MAX 40      // 10

#undef MOVE_UP
#undef MOVE_DOWN
#undef MOVE_LEFT
#undef MOVE_RIGHT
#define MOVE_UP MOVE_VERT(-MOUSE_MOVE_MAX)
#define MOVE_DOWN MOVE_VERT(MOUSE_MOVE_MAX)
#define MOVE_LEFT MOVE_HOR(-MOUSE_MOVE_MAX)
#define MOVE_RIGHT MOVE_HOR(MOUSE_MOVE_MAX)

#undef SCROLL_UP
#undef SCROLL_DOWN
#undef SCROLL_LEFT
#undef SCROLL_RIGHT
#define SCROLL_UP SCROLL_VERT(MOUSE_SCROLL_MAX)
#define SCROLL_DOWN SCROLL_VERT(-MOUSE_SCROLL_MAX)
#define SCROLL_LEFT SCROLL_HOR(-MOUSE_SCROLL_MAX)
#define SCROLL_RIGHT SCROLL_HOR(MOUSE_SCROLL_MAX)